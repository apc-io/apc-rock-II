## kernel/drivers/input/physics_key/Kconfig
```kconfig
#
# Input core configuration
#
config INPUT_PKEY
	bool "physics_key" if EMBEDDED || !X86
	default y
	depends on INPUT
	help
	  Say Y here, and a list of supported remote control devices will 
	  be displayed. This option doesn't affect the kernel.

	  If unsure, say y.

config PKEY_WonderMedia
	tristate "WonderMedia physics_key support" if !PC
	default y
	depends on INPUT && INPUT_PKEY
	help
	  Say Y here if you want remote control support for WonderMedia.

	  If unsure, say Y.

	  To compile this driver as a module, choose M here: the
	  module will be called wmt-pkey.
```

## kernel/drivers/input/sensor/Kconfig
```kconfig
#
# WMT Sensor configuration
#
config INPUT_SENSOR
	bool "WMT Sensor"
	help
	  Say Y here, and a list of supported sensor will be displayed.
	  This option doesn't affect the kernel.

	  If unsure, say Y.
```

## kernel/drivers/input/touchscreen/cyp140_ts/Kconfig
```kconfig
#
# CYP140 capacity touch screen driver configuration
#
config TOUCHSCREEN_CYP140
	tristate "CYPRESS CYP140 I2C Capacitive Touchscreen Input Driver Support"
	depends on ARCH_WMT
	default m
	help
	  Say Y here if you have an WMT based board with touchscreen
	  attached to it.

	  If unsure, say N.

	  To compile this driver as a module, choose M here: the
	  module will be called s_wmt_ts_cyp140
```

## kernel/drivers/input/touchscreen/gsl1680_ts/Kconfig
```kconfig
#
# GSL1680 capacity touch screen driver configuration
#
config TOUCHSCREEN_GSL1680
	tristate "ilead GSL1680 I2C Touchscreen Input Driver Support"
	depends on ARCH_WMT
	default y
	help
	  Say Y here if you have an WMT based board with touchscreen
	  attached to it.

	  If unsure, say N.

	  To compile this driver as a module, choose M here: the
	  module will be called s_wmt_ts_gsl1680.
```

## kernel/drivers/input/touchscreen/gt9xx_ts/Kconfig
```kconfig
config TOUCHSCREEN_GT9XX
        tristate "GT9XX Capacity Touchscreen Device Support"
        default y
        depends on ARCH_WMT
        ---help---
          Say Y here if you have an WMT based board with touchscreen
          attached to it.
          If unsure, say N.
          To compile this driver as a module, choose M here: the
          module will be called gt9xx.
```

## kernel/drivers/media/video/wmt/Kconfig
```kconfig
#
# Multimedia Video device configuration
#

config WMT_VIDEO_LOCK
	tristate "WonderMedia Video Lock"
	---help---
	  Say Y here to enable Video Lock

config WMT_VIDEO_DECODE_JPEG
	tristate "WonderMedia Hardware JPEG decoder"
	---help---
	  Say Y here to use hardware to decode JPEG files

config WMT_VIDEO_DECODE_MSVD
	tristate "WonderMedia Hardware MSVD decoder"
	---help---
	  Say Y here to use hardware to decode MSVD files
     
```

## kernel/drivers/media/video/wmt/encode/Kconfig
```kconfig
#
# Multimedia Video device configuration
#


config WMT_VIDEO_ENCODE_JPEG
	tristate "WonderMedia Hardware JPEG encoder"
	---help---
	  Say Y here to use hardware to encode JPEG files

config WMT_VIDEO_ENCODE_H264
	tristate "WonderMedia Hardware H264 encoder"
	---help---
	  Say Y here to use hardware to encode H264 files
     
```

## kernel/drivers/mfd/gmt/Kconfig
```kconfig
config MFD_GMT
	bool "GMT PMIC & Charger SUPPORT"
	depends on I2C=y
	select MFD_CORE
	select REGMAP_I2C
	select MFD_GMT_CORE
config MFD_GMT_CORE
	bool
```

## kernel/drivers/misc/rsa/Kconfig
```kconfig
menu "WMT RSA "
config WMT_RSA
	tristate "RSA"
	help
	  This enables the RSA decode/encode
endmenu
```

## kernel/drivers/mt5931/Kconfig
```kconfig
menu "MediaTek Connectivity MT5931 Config"

config MTK_MT5931
	bool "MediaTek Connectivity MT5931 Support"
	default y
	help
	  MTK connectivity wifi chip driver for MT5931


#choice
#	prompt "Select Chip"
#	depends on MTK_COMBO

#config MTK_WIFI_CHIP_MT5931
#	bool "MT5931"
#config MTK_COMBO_CHIP_MT6628
#	bool "MT6620"
#config MTK_COMBO_CHIP_MT6628
#	bool "MT6628"
#endchoice


config MTK_MT5931_WIFI
	tristate "MT5931 Wi-Fi"
	depends on MTK_MT5931
	depends on MMC
	depends on IPV6
	select WIRELESS_EXT
	select WEXT_PRIV
	default m
	help
	  This module adds support for wireless adapters based on
	  MTK MT5931 chipset.

	  This driver uses the kernel's wireless extensions subsystem.

	  If you choose to build a module, it'll be called dhd. Say M if
	  unsure.


config MTK_MT5931_DEBUG
	depends on MTK_MT5931_WIFI
	bool "Enable debug output from MT5931 driver"
	default n
	help
	  Enable debug messages output from MT5931 driver

config MTK_MT5931_WLAN_PROC
	depends on MTK_MT5931_WIFI
	bool "Enable procfs support"
	default n
	help
	  Enable procfs support.

config MTK_MT5931_SUPPORT_XLOG
	depends on MTK_MT5931_WIFI
	bool "Enable XLOG support in MT5931 driver"
	default n
	help
	Enable XLOG support for devices using MT5931

config MTK_MT5931_SUPPORT_AEE
	depends on MTK_MT5931_WIFI
	bool "Enable AEE support in MT5931 driver"
	default n
	help
	Enable AEE support for devices using MT5931

config MTK_MT5931_WAPI_SUPPORT
	depends on MTK_MT5931_WIFI
	bool "Enable WAPI support in MT5931 driver"
	default n
	help
	Enable WAPI support for devices using MT5931


endmenu
```

## kernel/drivers/power/g2214/Kconfig
```kconfig
config G2214_CHARGER
		tristate "GMT G2214 Charger driver (GMT & others)"
		depends on I2C
		help
			Say Y here to enable support for charger with g2214 chip.	  
```

## kernel/drivers/power/wmt_battery/charger/mps/Kconfig
```kconfig
config MPS_CHARGER
		tristate "MPS Charger driver (MPS & others)"
		help
			Say Y here to enable support for charger with mps chip.	  
```

## kernel/drivers/power/wmt_battery/gauge/Kconfig
```kconfig
config BATTERY_WMT
	tristate "wmt battery driver (wonder media & others)"
	help
	  Say Y here to enable support for batteries with wmt chip.
```
